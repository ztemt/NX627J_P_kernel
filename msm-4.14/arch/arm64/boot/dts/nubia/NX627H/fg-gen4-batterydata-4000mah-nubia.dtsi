
qcom,atl_nubia_4000mah {
	qcom,profile-revision = <24>;
	/* #atl_nubia_4000mah*/
	qcom,max-voltage-uv = <4400000>;
	qcom,fg-cc-cv-threshold-mv = <4390>;
	qcom,nom-batt-capacity-mah = <4020>;
	qcom,fastchg-current-ma = <5000>;
	qcom,jeita-fcc-ranges = < 0  60   390000
				 61 110  1100000
				111 380  5000000
				381 400  4000000
				401 430  3500000
				431 550  1000000>;
	qcom,jeita-fv-ranges = <0   60  4400000
				 61 110  4400000
				111 380  4400000
				381 400  4400000
				401 430  4400000
				431 550  4400000>;
	//qcom,step-chg-ranges = <3400000  4200000  4900000
				//4201000  4400000  4900000>;
	qcom,batt-id-kohm = <15>;
	qcom,battery-beta = <4250>;
	qcom,therm-room-temp = <100000>;
	qcom,battery-type = "atl_nubia_4000mah";
	qcom,therm-coefficients = <0x2318 0xd0c 0xdaf7 0xc556 0x848d>;
	qcom,therm-center-offset = <0x70>;
	qcom,therm-pull-up = <100>;
	qcom,rslow-normal-coeffs = <0xb1 0x07 0x08 0x13>;
	qcom,rslow-low-coeffs = <0x0a 0x15 0x27 0xfc>;
	qcom,checksum = <0x1DD6>;
	qcom,gui-version = "PM855GUI - 1.0.0.13";
	qcom,fg-profile-data = [
		 09 00 45 00
		 3A DC 6D E3
		 56 DC 00 00
		 8D BC 00 92
		 F3 87 84 94
		 03 8C 59 80
		 1E 00 B1 07
		 08 13 D7 FC
		 35 FA CE 07
		 32 00 8C EA
		 24 E4 52 DA
		 5C 0A 09 CB
		 C1 B5 D2 F3
		 53 F3 33 C2
		 60 00 44 00
		 47 00 41 00
		 35 00 32 00
		 34 00 3F 00
		 3F 00 43 00
		 44 00 60 00
		 3B 00 48 00
		 50 00 46 00
		 3D 00 76 00
		 65 64 51 00
		 46 00 47 08
		 60 00 47 00
		 47 00 62 10
		 56 10 47 00
		 80 28 66 48
		 52 60 47 0D
		 46 00 D8 F8
		 6B 1F B9 0D
		 4F 02 97 06
		 6E 1C 8C 0B
		 5F 0D EE 22
		 57 17 60 42
		 4D 55 20 02
		 62 12 30 1F
		 1B 04 28 0A
		 9E FE D8 1C
		 20 FA 70 FD
		 F4 02 F8 17
		 4C 23 40 45
		 29 53 6E 13
		 4A 20 03 ED
		 CD CA 29 D4
		 E9 1C C3 C2
		 21 04 69 BA
		 A7 17 69 93
		 32 85 25 A3
		 94 A0 09 80
		 01 F2 48 04
		 AE EA 92 E4
		 00 00 83 EC
		 10 EA F3 F7
		 1F E5 DA 9D
		 14 01 16 F0
		 22 D4 09 01
		 1A 04 E2 03
		 CE 07 32 00
		 58 01 39 02
		 5E 04 56 03
		 EB 02 5A 05
		 6F 03 6F 02
		 9A 05 4B 00
		 3D 00 53 00
		 60 64 72 00
		 74 00 77 08
		 77 F8 71 00
		 7A 00 85 10
		 3C 10 38 00
		 50 28 54 48
		 5F 60 6B 0C
		 4D 00 5E 00
		 6E 08 81 F8
		 67 00 3D 00
		 3B 10 4A 10
		 4C 00 59 28
		 64 48 47 58
		 54 0D 5C 00
		 65 00 47 08
		 D8 00 F7 1F
		 BB 05 25 0A
		 6D 0D BA 1C
		 99 23 88 45
		 88 52 59 18
		 37 02 4B 05
		 4D 02 6A 11
		 3F 0A AC 1F
		 A8 05 72 02
		 A1 04 A0 1C
		 91 03 68 05
		 DF 02 63 18
		 12 02 93 05
		 F5 03 63 00
		 97 1F B9 05
		 6E 02 50 06
		 D2 1C 69 02
		 25 05 21 03
		 8F 18 29 03
		 26 05 90 03
		 71 00 27 01
		 C0 00 FA 00
		 EB 0F 00 00
	];
};
