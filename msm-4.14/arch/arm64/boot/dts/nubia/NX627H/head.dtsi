/*
 * nubia overwrite dts
 */

#include "usb.dtsi"
#include "others.dtsi"
#include "neo-power.dtsi"
#include "sensors.dtsi"
#include "tp.dtsi"
#include "finger.dtsi"
#include "leds.dtsi"
#include "cs_press.dtsi"
#include "audio.dtsi"
#include "haptic.dtsi"
#include "display.dtsi"