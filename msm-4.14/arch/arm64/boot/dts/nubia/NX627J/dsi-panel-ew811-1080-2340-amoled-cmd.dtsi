/* Copyright (c) 2016-2017, The Linux Foundation. All rights reserved.
 *
 * This program is free software; you can redistribute it and/or modify
 * it under the terms of the GNU General Public License version 2 and
 * only version 2 as published by the Free Software Foundation.
 *
 * This program is distributed in the hope that it will be useful,
 * but WITHOUT ANY WARRANTY; without even the implied warranty of
 * MERCHANTABILITY or FITNESS FOR A PARTICULAR PURPOSE.  See the
 * GNU General Public License for more details.
 */

&mdss_mdp {
	dsi_ew811_1080_2340_amoled_cmd: qcom,mdss_dsi_ew811_1080_2340_amoled_cmd {
		qcom,mdss-dsi-panel-name = "dsi ew811 1080 2340 amoled cmd panel";
		qcom,mdss-dsi-panel-type = "dsi_cmd_mode";
		qcom,mdss-dsi-virtual-channel-id = <0>;
		qcom,mdss-dsi-stream = <0>;
		qcom,mdss-dsi-bpp = <24>;
		qcom,mdss-dsi-color-order = "rgb_swap_rgb";
		qcom,mdss-dsi-underflow-color = <0xff>;
		qcom,mdss-dsi-border-color = <0>;
		qcom,mdss-dsi-panel-blackness-level = <3230>;
		qcom,mdss-dsi-traffic-mode = "burst_sync_event";
		qcom,mdss-dsi-bllp-eof-power-mode;
		qcom,mdss-dsi-bllp-power-mode;
		qcom,mdss-dsi-lane-0-state;
		qcom,mdss-dsi-lane-1-state;
		qcom,mdss-dsi-lane-2-state;
		qcom,mdss-dsi-lane-3-state;
		qcom,mdss-dsi-dma-trigger = "trigger_sw";
		qcom,mdss-dsi-mdp-trigger = "none";
		qcom,mdss-dsi-reset-sequence =<0 10>,<1 10>;
		qcom,mdss-dsi-bl-pmic-control-type = "bl_ctrl_dcs";
		qcom,mdss-dsi-bl-min-level = <1>;
		qcom,mdss-dsi-bl-max-level = <1023>;
		qcom,mdss-brightness-max-level = <4080>;
		qcom,adjust-timer-wakeup-ms = <1>;
		qcom,mdss-dsi-te-pin-select = <1>;

		qcom,mdss-dsi-wr-mem-start = <0x2c>;
		qcom,mdss-dsi-wr-mem-continue = <0x3c>;
		qcom,mdss-dsi-mode-sel-gpio-state = "single_port";
		qcom,panel-supply-entries = <&nubia_front_dsi_panel_pwr_supply>;

		qcom,panel-mode-gpio = <&tlmm 7 0>;
		qcom,platform-te-gpio = <&tlmm 8 0>;
		qcom,platform-reset-gpio = <&tlmm 6 0>;
		qcom,front-panel-vci-3p3-gpio = <&tlmm 130 0>;
		qcom,front-panel-f-fd-gpio = <&tlmm 49 0>;

		qcom,mdss-dsi-te-dcs-command = <1>;
		qcom,mdss-dsi-te-check-enable;
		qcom,mdss-dsi-te-using-te-pin;
		qcom,mdss-dsi-t-clk-post = <0x14>;
		qcom,mdss-dsi-t-clk-pre = <0x10>;

		/********************** ESD CHECK START *************************/
		qcom,esd-check-enabled;
		qcom,mdss-dsi-panel-status-command = [06 01 00 01 05 00 01 0a];
		qcom,mdss-dsi-panel-status-command-state = "dsi_lp_mode";
		qcom,mdss-dsi-panel-status-check-mode = "reg_read";
		qcom,mdss-dsi-panel-status-read-length = <1>;
		qcom,mdss-dsi-panel-max-error-count = <1>;
		qcom,mdss-dsi-panel-status-value = <0x9c>;
		/******************** ESD CHECK END ****************************/

		qcom,mdss-dsi-display-timings {
			timing@0{
				qcom,mdss-dsi-panel-framerate = <60>;
				qcom,mdss-dsi-panel-width = <1080>;
				qcom,mdss-dsi-panel-height = <2340>;
				qcom,mdss-dsi-h-front-porch = <40>;
				qcom,mdss-dsi-h-back-porch = <80>;
				qcom,mdss-dsi-h-pulse-width = <8>;
				qcom,mdss-dsi-h-sync-skew = <0>;
				qcom,mdss-dsi-v-back-porch = <40>;
				qcom,mdss-dsi-v-front-porch = <40>;
				qcom,mdss-dsi-v-pulse-width = <2>;
				qcom,mdss-dsi-h-left-border = <0>;
				qcom,mdss-dsi-h-right-border = <0>;
				qcom,mdss-dsi-h-sync-pulse = <0>;
				qcom,mdss-dsi-v-top-border = <0>;
				qcom,mdss-dsi-v-bottom-border = <0>;
				qcom,mdss-dsi-panel-phy-timings = [00 10 04 04 1E 1E 04 04 02 02 04 00 10 14];
				qcom,display-topology = <1 1 1>;
				qcom,default-topology-index = <0>;
				qcom,mdss-dsi-panel-jitter = <0x3C 0x0a>;

				//DSC MODE
				qcom,mdss-dsi-on-command = [
					39 01 00 00 00 00 03 43 01 02
					39 01 00 00 00 00 03 44 07 D0
					39 01 00 00 00 00 02 35 00
					39 01 00 00 00 00 02 53 20
					07 01 00 00 00 00 02 01 00
					0A 01 00 00 00 00 59 A3 11 00 00 89 30 80 09 24 04 38 00 3C 02 1C 02 1C 02 00 02 0E 00 20 05 D2 00 07 00 0C 01 A1 01 B2 18 00 10 F0 03 0C 20 00 06 0B 0B 33 0E 1C 2A 38 46 54 62 69 70 77 79 7B 7D 7E 01 02 01 00 09 40 09 BE 19 FC 19 FA 19 F8 1A 38 1A 78 1A B6 2A F6 2B 34 2B 74 3B 74 6B F4
					05 01 00 00 32 00 01 11
					39 01 00 00 00 00 03 F0 5A 5A
					39 01 00 00 00 00 02 E2 6D
					39 01 00 00 00 00 15 B2 60 09 24 04 38 08 08 02 44 02 50 08 3C 08 00 00 02 51 A0 00
					39 01 00 00 00 00 02 B0 01
					39 01 00 00 00 00 03 C2 01 FF
					39 01 00 00 00 00 02 B0 05
					39 01 00 00 00 00 03 C2 00 48
					39 01 00 00 00 00 02 B0 07
					39 01 00 00 00 00 03 C2 00 6F
					39 01 00 00 00 00 02 B0 09
					39 01 00 00 00 00 03 C2 00 EB
					39 01 00 00 00 00 03 E0 FF FF
					39 01 00 00 00 00 02 C0 F8
					39 01 00 00 00 00 03 F0 A5 A5
					05 01 00 00 14 00 01 29
				];

				qcom,mdss-dsi-off-command = [
					05 01 00 00 14 00 01 28
					05 01 00 00 0A 00 01 10];
				qcom,mdss-dsi-on-command-state = "dsi_lp_mode";
				qcom,mdss-dsi-off-command-state = "dsi_hs_mode";

				qcom,compression-mode = "dsc";
				qcom,mdss-dsc-slice-height = <60>;
				qcom,mdss-dsc-slice-width = <540>;
				qcom,mdss-dsc-slice-per-pkt = <2>;
				qcom,mdss-dsc-bit-per-component = <8>;
				qcom,mdss-dsc-bit-per-pixel = <8>;
				qcom,mdss-dsc-block-prediction-enable;

				/*************************************** AOD START *******************************************/
				nubia,mdss-dsi-sub-lcd-command-aod-on = [
					39 01 00 00 14 00 03 51 00 FF
					39 01 00 00 14 00 0B 90 01 00 00 00 00 00 04 38 09 24
					39 01 00 00 00 00 03 F0 5A 5A
					39 01 00 00 00 00 02 B0 05
					39 01 00 00 00 00 02 B5 28
					39 01 00 00 00 00 03 F0 A5 A5
					39 01 00 00 00 00 03 51 00 FF];
				nubia,mdss-dsi-sub-lcd-command-aod-off = [
					39 01 00 00 00 00 0B 90 00 00 00 00 00 00 04 38 09 24];
				nubia,mdss-dsi-command-aod-b1 = [39 01 00 00 14 00 03 51 00 D0];
				nubia,mdss-dsi-command-aod-b2 = [39 01 00 00 14 00 03 51 00 D9];
				nubia,mdss-dsi-command-aod-b3 = [39 01 00 00 14 00 03 51 00 E0];
				nubia,mdss-dsi-command-aod-b4 = [39 01 00 00 14 00 03 51 00 E9];
				nubia,mdss-dsi-command-aod-b5 = [39 01 00 00 14 00 03 51 00 F0];
				nubia,mdss-dsi-command-aod-b6 = [39 01 00 00 14 00 03 51 00 FF];
				nubia,mdss-dsi-sub-lcd-command-aod-on-state = "dsi_hs_mode";
				nubia,mdss-dsi-sub-lcd-command-aod-off-state = "dsi_hs_mode";
				nubia,mdss-dsi-command-aod-b1-state = "dsi_hs_mode";
				nubia,mdss-dsi-command-aod-b2-state = "dsi_hs_mode";
				nubia,mdss-dsi-command-aod-b3-state = "dsi_hs_mode";
				nubia,mdss-dsi-command-aod-b4-state = "dsi_hs_mode";
				nubia,mdss-dsi-command-aod-b5-state = "dsi_hs_mode";
				nubia,mdss-dsi-command-aod-b6-state = "dsi_hs_mode";
				/*************************************** AOD END ********************************************/

				/*************************************** HBM START ******************************************/
				nubia,mdss-dsi-hbm-command-on = [39 01 00 00 00 00 03 51 04 FF];
				nubia,mdss-dsi-hbm-command-off = [39 01 00 00 00 00 03 51 03 FF];
				nubia,mdss-dsi-hbm-command-on-state = "dsi_hs_mode";
				nubia,mdss-dsi-hbm-command-off-state = "dsi_hs_mode";
				/*************************************** HBM END *******************************************/

				/*************************************** ACL START *****************************************/
				nubia,mdss-dsi-cabc-command-off = [15 01 00 00 00 00 02 55 00];
				nubia,mdss-dsi-cabc-command-level1 = [15 01 00 00 00 00 02 55 01];
				nubia,mdss-dsi-cabc-command-level2 = [15 01 00 00 00 00 02 55 02];
				nubia,mdss-dsi-cabc-command-level3 = [15 01 00 00 00 00 02 55 03];
				nubia,mdss-dsi-cabc-command-off-state = "dsi_hs_mode";
				nubia,mdss-dsi-cabc-command-level1-state = "dsi_hs_mode";
				nubia,mdss-dsi-cabc-command-level2-state = "dsi_hs_mode";
				nubia,mdss-dsi-cabc-command-level3-state = "dsi_hs_mode";
				/*************************************** ACL END *****************************************/

				/*************************************** sRGB START **************************************/
				nubia,mdss-dsi-srgb-command-on = [
					39 01 00 00 00 00 03 F0 5A 5A
					39 01 00 00 00 00 02 DD 00
					39 01 00 00 00 00 03 F0 A5 A5];
				nubia,mdss-dsi-srgb-command-off = [
					39 01 00 00 00 00 03 F0 5A 5A
					39 01 00 00 00 00 02 DD 01
					39 01 00 00 00 00 03 F0 A5 A5];
				nubia,mdss-dsi-srgb-command-on-state = "dsi_hs_mode";
				nubia,mdss-dsi-srgb-command-off-state = "dsi_hs_mode";
				/*************************************** sRGB END ***************************************/

				/*************************************** EYE PROTECTION *********************************/
				nubia,mdss-dsi-eye-pro-command-off = [
					39 01 00 00 00 00 03 F0 5A 5A
					39 01 00 00 00 00 02 B0 01
					39 01 00 00 00 00 02 BE 00
					39 01 00 00 00 00 03 F0 A5 A5];
				nubia,mdss-dsi-eye-pro-command-level1 = [
					39 01 00 00 00 00 03 F0 5A 5A
					39 01 00 00 00 00 02 B0 01
					39 01 00 00 00 00 02 BE 02
					39 01 00 00 00 00 02 B0 64
					39 01 00 00 00 00 04 BE 72 67 56
					39 01 00 00 00 00 03 F0 A5 A5];
				nubia,mdss-dsi-eye-pro-command-level2 = [
					39 01 00 00 00 00 03 F0 5A 5A
					39 01 00 00 00 00 02 B0 01
					39 01 00 00 00 00 02 BE 02
					39 01 00 00 00 00 02 B0 64
					39 01 00 00 00 00 04 BE 7C 5F 3D
					39 01 00 00 00 00 03 F0 A5 A5];
				nubia,mdss-dsi-eye-pro-command-off-state = "dsi_hs_mode";
				nubia,mdss-dsi-eye-pro-command-level1-state = "dsi_hs_mode";
				nubia,mdss-dsi-eye-pro-command-level2-state = "dsi_hs_mode";
				/************************************ EYE PROTECTION END ****************************/

				/*************************************** CONTRAST ENCHANCE START *******************************************/
				nuiba,mdss-dsi-contrast-command-on = [
					39 01 00 00 00 00 03 F0 5A 5A
					39 01 00 00 00 00 02 BF 08
					39 01 00 00 00 00 02 B0 6F
					39 01 00 00 00 00 0A BE 20 40 60 80 90 94 90 88 80
					39 01 00 00 00 00 03 F0 A5 A5];
				nuiba,mdss-dsi-contrast-command-off = [
					39 01 00 00 00 00 03 F0 5A 5A
					39 01 00 00 00 00 02 BF 00
					39 01 00 00 00 00 03 F0 A5 A5];
				nuiba,mdss-dsi-contrast-command-on-state = "dsi_hs_mode";
				nuiba,mdss-dsi-contrast-command-off-state = "dsi_hs_mode";
				/*************************************** CONTRAST ENCHANCE END ********************************************/
			};
		};
	};
};
